## conf/layer.conf
```bitbake
# We have a conf and classes directory, add to BBPATH
BBPATH =. "${LAYERDIR}:"

# We have a packages directory, add to BBFILES
BBFILES += " ${LAYERDIR}/recipes-*/*/*.bb "
BBFILES += " ${LAYERDIR}/recipes-*/*/*.bbappend "

BBFILE_COLLECTIONS += "wr-marvell-cn106xx"
BBFILE_PATTERN_wr-marvell-cn106xx := "^${LAYERDIR}/"
BBFILE_PRIORITY_wr-marvell-cn106xx = "7"

# This should only be incremented on significant changes that will
# cause compatibility issues with other layers
LAYERVERSION_wr-marvell-cn106xx = "1"

LAYERDEPENDS_wr-marvell-cn106xx = "core wrlinux meta-arm"
LAYERSERIES_COMPAT_wr-marvell-cn106xx = "wrl kirkstone"

# We have a pre-populated downloads directory, add to PREMIRRORS
PREMIRRORS:append = " \
     https://.*/.* file://${LAYERDIR}/downloads/ \n \
"
PNWHITELIST_REASON:wr-marvell-cn106xx = "You are about to enable third-party components, there is additional third-part \
licensing involved, and you might need to consult with your legal department."
```

## conf/machine/marvell-cn106xx.conf
```bitbake
#@TYPE: Machine
#@NAME: marvell-cn106xx
#@DESCRIPTION: Machine configuration for Marvell CN106xx SoC

# So far there is no Neoverse P1 core support in gcc
DEFAULTTUNE = "neoversen2-crypto"
require conf/machine/include/arm/armv9a/tune-neoversen2.inc

MACHINE_FEATURES = "ext3 pci usbhost vfat"

KERNEL_IMAGETYPE = "Image"

SERIAL_CONSOLES ?= "115200;ttyAMA0"
SERIAL_CONSOLES_CHECK ?= "${SERIAL_CONSOLES}"

IMAGE_FSTYPES += "tar.bz2"

MACHINE_EXTRA_RRECOMMENDS = " kernel-modules"
IMAGE_FSTYPES += "tar.bz2 wic wic.bmap"
IMAGE_TYPEDEP_wic = "tar.bz2"
WKS_FILE ?= "cn106xx-sdimage-bootpart.wks"
do_image_wic[depends] += "mtools-native:do_populate_sysroot dosfstools-native:do_populate_sysroot"
IMAGE_INSTALL_append = " kernel-image-image"
IMAGE_BOOT_FILES ?= " Image"

PREFERRED_PROVIDER_virtual/kernel ??= "linux-yocto"
```

## conf/machine/marvell-cn10xxx.conf
```bitbake
#@TYPE: Machine
#@NAME: marvell-cn10xxx
#@DESCRIPTION: Machine configuration for Marvell CN10xxx SoC

# So far there is no Neoverse P1 core support in gcc
DEFAULTTUNE = "neoversen2-crypto"
require conf/machine/include/arm/armv9a/tune-neoversen2.inc

MACHINE_FEATURES = "ext3 pci usbhost vfat"

KERNEL_IMAGETYPE = "Image"

SERIAL_CONSOLES ?= "115200;ttyAMA0"
SERIAL_CONSOLES_CHECK ?= "${SERIAL_CONSOLES}"

IMAGE_FSTYPES += "tar.bz2"

MACHINE_EXTRA_RRECOMMENDS = " kernel-modules"
IMAGE_FSTYPES += "tar.bz2 wic wic.bmap"
IMAGE_TYPEDEP:wic = "tar.bz2"
WKS_FILE ?= "cn10xxx-sdimage-bootpart.wks"
do_image_wic[depends] += "mtools-native:do_populate_sysroot dosfstools-native:do_populate_sysroot"
IMAGE_INSTALL:append = " kernel-image-image"
IMAGE_BOOT_FILES ?= " Image"

PREFERRED_PROVIDER_virtual/kernel ??= "linux-yocto"
PREFERRED_VERSION_linux-yocto ?= "6.1%"
PREFERRED_VERSION_linux-yocto-rt ?= "6.1%"

# multilib support
MULTILIBS ?= "multilib:lib32"
DEFAULTTUNE:virtclass-multilib-lib32 ?= "armv7athf-neon"
```
